## firmware/main/Kconfig.projbuild
```kconfig
menu "BlueBox Configuration"

    choice BLUEBOX_RECOVERY_MODE
        prompt "Recovery Mode Type"
        default BLUEBOX_RECOVERY_MODE_AP
        help
            Select the recovery mode behavior after landing detection.

            AP Mode: Creates a WiFi access point "BlueBox" for manual data retrieval
            Station Mode: Connects to configured WiFi network and uploads data automatically

        config BLUEBOX_RECOVERY_MODE_AP
            bool "AP Mode (Access Point)"
            help
                Device creates its own WiFi network for manual data download

        config BLUEBOX_RECOVERY_MODE_STATION
            bool "Station Mode (Connect to WiFi)"
            help
                Device connects to configured WiFi network and uploads data to webapp
    endchoice

    menu "Station Mode Configuration"
        visible if BLUEBOX_RECOVERY_MODE_STATION

        config BLUEBOX_WIFI_SSID
            string "WiFi SSID"
            default "YourWiFiNetwork"
            help
                Name of the WiFi network to connect to

        config BLUEBOX_WIFI_PASSWORD
            string "WiFi Password"
            default "YourWiFiPassword"
            help
                Password for the WiFi network

        config BLUEBOX_WEBAPP_URL
            string "Webapp API URL"
            default "http://192.168.1.100:8049"
            help
                URL of the BlueBox webapp API endpoint (without /api/flights)
                Example: http://192.168.1.100:8049 or http://bluebox.local:8049

        config BLUEBOX_DEVICE_ID
            string "Device ID"
            default "bluebox-001"
            help
                Unique identifier for this BlueBox device

        config BLUEBOX_WIFI_RETRY_INTERVAL_SEC
            int "WiFi Connection Retry Interval (seconds)"
            default 10
            range 5 60
            help
                Time to wait between WiFi connection attempts

        config BLUEBOX_UPLOAD_RETRY_INTERVAL_SEC
            int "Upload Retry Interval (seconds)"
            default 30
            range 10 120
            help
                Time to wait between upload attempts after WiFi is connected
    endmenu

    config BLUEBOX_AUDIO_FEEDBACK
        bool "Enable Audio Feedback"
        default y
        help
            Enable audio tones for status indication during recovery mode

endmenu
```

## firmware/sdkconfig.defaults
```kconfig
# BlueBox Flight Recorder Configuration
# Optimized for maximum performance during short flights

# CPU Configuration
CONFIG_ESP32_DEFAULT_CPU_FREQ_240=y
CONFIG_FREERTOS_HZ=1000

# Memory Configuration
# PSRAM disabled - not available on this board

# WiFi Configuration (reduced buffers for memory savings)
CONFIG_ESP_WIFI_STATIC_RX_BUFFER_NUM=4
CONFIG_ESP_WIFI_DYNAMIC_RX_BUFFER_NUM=16
CONFIG_ESP_WIFI_DYNAMIC_TX_BUFFER_NUM=16
CONFIG_ESP_WIFI_AMPDU_TX_ENABLED=n
CONFIG_ESP_WIFI_AMPDU_RX_ENABLED=n

# Compiler Optimizations
CONFIG_COMPILER_OPTIMIZATION_PERF=y
CONFIG_COMPILER_OPTIMIZATION_ASSERTIONS_DISABLE=y

# Log Level (reduce to WARNING in production for speed)
CONFIG_LOG_DEFAULT_LEVEL_INFO=y

# SPI Configuration
CONFIG_SPI_MASTER_ISR_IN_IRAM=y

# Task Watchdog (disable during flight for max speed)
CONFIG_ESP_TASK_WDT=n

# Main task stack size (increased for WiFi initialization and PHY calibration)
CONFIG_ESP_MAIN_TASK_STACK_SIZE=8192

# Brownout detector (may trigger during WiFi PHY init)
CONFIG_ESP_BROWNOUT_DET=n

# Flash Size
CONFIG_ESPTOOLPY_FLASHSIZE_4MB=y

# Partition Table
CONFIG_PARTITION_TABLE_CUSTOM=y
CONFIG_PARTITION_TABLE_CUSTOM_FILENAME="partitions.csv"
CONFIG_PARTITION_TABLE_FILENAME="partitions.csv"

# TLS/SSL Configuration (for HTTPS support without certificate verification)
CONFIG_ESP_TLS_SKIP_SERVER_CERT_VERIFY=y
```

## sdkconfig.defaults
```kconfig
# BlueBox Flight Recorder Configuration
# Optimized for maximum performance during short flights

# CPU Configuration
CONFIG_ESP32_DEFAULT_CPU_FREQ_240=y
CONFIG_FREERTOS_HZ=1000

# Memory Configuration
# PSRAM disabled - not available on this board

# WiFi Configuration (disabled during flight, enabled post-flight)
CONFIG_ESP32_WIFI_STATIC_RX_BUFFER_NUM=10
CONFIG_ESP32_WIFI_DYNAMIC_RX_BUFFER_NUM=32
CONFIG_ESP32_WIFI_DYNAMIC_TX_BUFFER_NUM=32

# Compiler Optimizations
CONFIG_COMPILER_OPTIMIZATION_PERF=y
CONFIG_COMPILER_OPTIMIZATION_ASSERTIONS_DISABLE=y

# Log Level (reduce to WARNING in production for speed)
CONFIG_LOG_DEFAULT_LEVEL_INFO=y

# SPI Configuration
CONFIG_SPI_MASTER_ISR_IN_IRAM=y

# Task Watchdog (disable during flight for max speed)
CONFIG_ESP_TASK_WDT=n
```
